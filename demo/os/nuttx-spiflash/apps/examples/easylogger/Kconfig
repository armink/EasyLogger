## demo/os/nuttx-spiflash/apps/examples/easylogger/Kconfig
```kconfig
#
# For a description of the syntax of this configuration file,
# see the file kconfig-language.txt in the NuttX tools repository.
#

config EXAMPLES_EASYLOGGER
	tristate "Easylogger and EasyFlash Demo"
	default n
	select SYSTEM_EASYLOGGER
	select SYSTEM_EASYLOGGER_FLASH
	select SYSTEM_EASYFLASH
	select CONFIG_MTD
	select CONFIG_MTD_BYTE_WRITE
	select CONFIG_MTD_W25
	---help---
		Enable the Easylogger Demo

if EXAMPLES_EASYLOGGER

config EXAMPLES_EASYLOGGER_PROGNAME
	string "Program name"
	default "elog"
	---help---
		This is the name of the program that will be used when the NSH ELF
		program is installed.

config EXAMPLES_EASYLOGGER_PRIORITY
	int "Easylogger task priority"
	default 100

config EXAMPLES_EASYLOGGER_STACKSIZE
	int "Easylogger stack size"
	default DEFAULT_TASK_STACKSIZE

endif
```

## demo/os/nuttx-spiflash/apps/system/easyflash/Kconfig
```kconfig
#
# For a description of the syntax of this configuration file,
# see the file kconfig-language.txt in the NuttX tools repository.
#

menuconfig SYSTEM_EASYFLASH
	tristate "Easyflash"
	default n
	---help---
		Enable support for the Easyflash

if SYSTEM_EASYFLASH


endif # SYSTEM_EASYFLASH
```

## demo/os/nuttx-spiflash/apps/system/easylogger/Kconfig
```kconfig
#
# For a description of the syntax of this configuration file,
# see the file kconfig-language.txt in the NuttX tools repository.
#

menuconfig SYSTEM_EASYLOGGER
	tristate "Easylogger"
	default n
	---help---
		Enable support for the Easylogger

if SYSTEM_EASYLOGGER

config SYSTEM_EASYLOGGER_FILE
	bool "Enable EasyLogger File"
	default n
	---help---
		Add EasyLogger File support.

config SYSTEM_EASYLOGGER_FLASH
	bool "Enable EasyLogger Flash"
	default n
	select SYSTEM_EASYFLASH
	---help---
		Add EasyLogger Flash support.

endif # SYSTEM_EASYLOGGER
```
